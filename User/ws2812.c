/**
  ******************************************************************************
  * @file    ws2812.c
  * @brief   WS2812C-2020 驱动实现（SPI 10 位帧，阻塞发送）
  ******************************************************************************
  */

#include "ws2812.h"

/* ==========================================================================
 *                              内部数据
 * ========================================================================== */

/* 码型常量：一个 SPI 帧（10 位）= 一个 WS2812 码
 *
 *   SPI 时钟 8MHz → 1 位 = 125ns，一帧 10 位 = 1.25μs（= WS2812C 位周期）
 *
 *   0 码 = 1100000000 (0x0300) → 高 250ns / 低 1000ns
 *   1 码 = 1111100000 (0x03E0) → 高 625ns / 低 625ns
 *
 * 为什么 0 码取「2 高 8 低」而不是「3 高 7 低」：
 *   边沿变缓时，因 VIH(2.7V=54%)/VIL(0.7V=14%) 不对称，高电平会被拉长约
 *   0.16×(tr+tf)。若取 375ns，加边沿后约 381ns 会突破 380ns 上限，
 *   0 码被误判成 1 码（表现为设 000 却亮白）。取 250ns 加边沿约 256ns，
 *   离上限还有 124ns 余量。
 *
 * 对照手册：T0H 220~380 / T0L 580~1000 / T1H 580~1000 / T1L 580~1000 ns
 */
#define WS2812_PAT_0        0x0300U
#define WS2812_PAT_1        0x03E0U

/* 一颗灯 24 个码（G、R、B 各 8 位，MSB 先行） */
#define WS2812_CODES_PER_LED    24U

/* 复位用零码个数：每个零码 10 位 = 1.25μs，
 * 256 个 = 320μs > 280μs（WS2812C 复位门限） */
#define WS2812_RESET_CODES      256U

/* 整帧码缓冲：每颗灯 24 个 uint16_t，SetPixel 时直接写到对应位置 */
static uint16_t s_code_buf[WS2812_LED_MAX * WS2812_CODES_PER_LED];

/* ==========================================================================
 *                              内部函数
 * ========================================================================== */

/**
  * @brief  把 24bit 颜色编码成 24 个码，直接写进码缓冲
  * @param  g    绿色
  * @param  r    红色
  * @param  b    蓝色
  * @param  out  输出缓冲（24 个 uint16_t）
  *
  * @note   按 WS2812 规范，颜色按 G→R→B、每字节 MSB 先行。
  *         这里不再需要任何「凑字节」的位打包逻辑 —— 一个码就是一个
  *         SPI 帧，直接写码型即可。
  */
static void WS2812_Encode(uint8_t g, uint8_t r, uint8_t b, uint16_t *out)
{
    uint32_t data;
    int8_t   i;

    data = ((uint32_t)g << 16) | ((uint32_t)r << 8) | (uint32_t)b;

    for (i = 23; i >= 0; i--)
    {
        *out++ = (((data & (1UL << (uint8_t)i)) != 0UL) ? (uint16_t)WS2812_PAT_1
                                                        : (uint16_t)WS2812_PAT_0);
    }
}

/**
  * @brief  产生 WS2812C 复位信号（数据线保持低电平 >280μs）
  *
  * @note   做法：连续写入 0 码。一个 0 码帧是 10 个 0 位 = 全低电平
  *           1.25μs，256 个 = 320μs > 280μs 要求。
  *
  * @note   ★ 这里直接操作 SPI 寄存器而不是调用 SPI1_WriteFrame()：
  *           256 次函数调用的开销会把时间拉长不说，关键是没必要。
  *           另外绝不能传空指针 —— 曾经传 0x00 给发送函数，让它去读
  *           地址 0x00000000（Cortex-M0 上是中断向量表），读出来的是
  *           SP 的低字节（本工程为 0xB0），发出去就是一串高电平脉冲，
  *           整个「复位」反而变成了一帧错误数据。
  */
static void WS2812_Reset(void)
{
    uint16_t i;

    for (i = 0U; i < WS2812_RESET_CODES; i++)
    {
        while ((SPI1->SR & SPI_SR_TXE) == 0U)
        {
            /* 等发送缓冲空 */
        }
        SPI1->DR = 0U;              /* 10 位全 0 = 一整帧低电平 */
    }

    /* 等最后一位真正移出，保证复位期间 MOSI 一直是低电平 */
    while ((SPI1->SR & SPI_SR_BSY) != 0U)
    {
    }
}

/* ==========================================================================
 *                              对外接口
 * ========================================================================== */

/**
  * @brief  初始化：把整帧码缓冲填成 0 码（全黑）+ 初始化 SPI1（8MHz）
  */
void WS2812_Init(void)
{
    uint16_t i;

    for (i = 0U; i < (uint16_t)(WS2812_LED_MAX * WS2812_CODES_PER_LED); i++)
    {
        s_code_buf[i] = (uint16_t)WS2812_PAT_0;     /* 全 0 码 = 全黑 */
    }

    SPI1_Init();                        /* 8MHz、10 位帧、只发送，见 spi1.h */
}

/**
  * @brief  设置单个像素颜色（编码到整帧缓冲，不发送）
  * @param  idx  像素索引，0 ~ WS2812_LED_MAX-1
  * @param  r    红色 0~255
  * @param  g    绿色 0~255
  * @param  b    蓝色 0~255
  * @note   注意 WS2812 的物理顺序是 GRB，本函数内部已处理，按 RGB 传即可
  */
void WS2812_SetPixel(uint16_t idx, uint8_t r, uint8_t g, uint8_t b)
{
    if (idx >= WS2812_LED_MAX)
    {
        return;
    }

    WS2812_Encode(g, r, b, &s_code_buf[idx * WS2812_CODES_PER_LED]);
}

/**
  * @brief  把所有像素填成同一颜色（只改缓冲，不发送）
  */
void WS2812_Fill(uint8_t r, uint8_t g, uint8_t b)
{
    uint16_t i;

    for (i = 0U; i < WS2812_LED_MAX; i++)
    {
        WS2812_SetPixel(i, r, g, b);
    }
}

/**
  * @brief  把整帧缓冲一次性发出去
  * @note   全部 LED 的码一次 SPI 发完，中间没有函数调用间隙；
  *         发完自动产生 >300μs 的复位低电平。
  * @note   每帧 10 位 = 1 个码，所以帧边界一定是码边界，
  *         高电平不会跨帧被劈开（详见 spi1.h 的说明）。
  */
void WS2812_Show(void)
{
    SPI1_TransmitFrames(s_code_buf,
                        (uint16_t)(WS2812_LED_MAX * WS2812_CODES_PER_LED));

    WS2812_Reset();
}
